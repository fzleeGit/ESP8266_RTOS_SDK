## myPrj/xLibEsp8266Rtos3.1AirKiss/sdkconfig.defaults
```kconfig
CONFIG_LTM_FAST=y
SDKCONFIG_DEFAULTS=y
CONFIG_ESPTOOLPY_PORT="COM10"
# FreeRTOS
CONFIG_FREERTOS_HZ=1000
#define CONFIG_ESP_WIFI_SSID="OP"
#define CONFIG_ESP_WIFI_PASSWORD="888888888"
```
